## boards/shields/splinch/Kconfig.defconfig
```kconfig
if splinch_dongle

config ZMK_KEYBOARD_NAME
    default "splinch"

config ZMK_SPLIT_ROLE_CENTRAL
    default y

config ZMK_SPLIT
    default y

config ZMK_SPLIT_BLE_CENTRAL_PERIPHERALS
    default 2

config BT_MAX_CONN
default 6

cofig BT_MAX_OAIRED

endif
```

## boards/shields/splinch/Kconfig.shield
```kconfig
config SHIELD_SPLINCH_LEFT
    def_bool $(shields_list_contains,splinch_left)

config SHIELD_SPLINCH_RIGHT
    def_bool $(shields_list_contains,splinch_right)

config SHIELD_SPLINCH_DONGLE
    def_bool $(shields_list_contains,splinch_dongle)
```
