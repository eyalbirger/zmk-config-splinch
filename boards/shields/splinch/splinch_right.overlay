// This file was generated from a template. Edit it to match your keyboard.
// See https://zmk.dev/docs/development/hardware-integration/new-shield for more
// instructions.

#include "splinch.dtsi"
#include <dt-bindings/zmk/matrix_transform.h>

    &default_transform {
        // Set this to the number of columns on the left side.
        col-offset = <7>;


    };
    #if !defined(SHIELD_SPLINCH_DONGLE)
    &kscan {
        // Replace these comments with the GPIO pins in the matrix for the right side.
        // See https://zmk.dev/docs/development/hardware-integration/new-shield#shield-overlays
        col-gpios
            = <&gpio0 10 GPIO_ACTIVE_HIGH>
            , <&gpio0 5 GPIO_ACTIVE_HIGH>
            , <&gpio1 11 GPIO_ACTIVE_HIGH>
            , <&gpio0 4 GPIO_ACTIVE_HIGH>
            , <&gpio0 29 GPIO_ACTIVE_HIGH>
            , <&gpio0 28 GPIO_ACTIVE_HIGH>
            , <&gpio0 3 GPIO_ACTIVE_HIGH>
            ;
    };
    #endif



